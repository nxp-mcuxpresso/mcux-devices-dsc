## MC56F82xxx/MC56F82623/Kconfig.chip
```kconfig
# core related
config MCUX_HW_CORE
    string
    default "dsp56800ex"

config MCUX_HW_CORE_DSP56800EX
    bool
    default y

config MCUX_HW_CORE_DSC
    bool
    default y

config MCUX_HW_CORE_ID
    string
    default "core0"

config MCUX_HW_CORE_ID_CORE0
    bool
    default y

config MCUX_HW_DEVICE_CORE
    string
    default "MC56F82623"

config MCUX_HW_FPU
    string
    default "NO_FPU"

config MCUX_HW_FPU_TYPE
    string
    default "no_fpu"

config MCUX_HW_NO_FPU
    bool
    default y

config MCUX_HW_SOC_SERIES_DSC
    bool
    default y

config MCUX_HW_SOC_SINGLECORE_DEVICE
    bool
    default y

# device related

config MCUX_HW_DEVICE_ID_MC56F82623
    bool

choice MCUX_HW_DEVICE_PART_MC56F82623
    prompt "Device MC56F82623 Part"
    config MCUX_HW_DEVICE_PART_MC56F82623VLC
        bool "MC56F82623VLC"
        select MCUX_HW_DEVICE_ID_MC56F82623
endchoice

config MCUX_HW_DEVICE_ID
    string
    default "MC56F82623" if MCUX_HW_DEVICE_ID_MC56F82623

config MCUX_HW_DEVICE_PART
    string
    default "MC56F82623VLC" if MCUX_HW_DEVICE_PART_MC56F82623VLC

# For chipmodel generated files
config MCUX_TOOLCHAIN_LINKER_DEVICE_PREFIX
    string
    default "MC56F82623" if MCUX_HW_DEVICE_ID_MC56F82623

# Toolchain related

config MCUX_TOOLCHAIN_JLINK_CPU_IDENTIFIER
    string
    default "MC56F82623" if MCUX_HW_DEVICE_ID_MC56F82623

config MCUX_TOOLCHAIN_CODEWARRIOR_CPU_IDENTIFIER
    string
    default "MC56F826xx" if MCUX_HW_DEVICE_ID_MC56F82623

# ip information
config MCUX_HW_IP_DriverType_DSC_AOI
    bool
    default y
    depends on MCUX_HW_DEVICE_ID_MC56F82623

config MCUX_HW_IP_DriverType_DSC_CADC
    bool
    default y
    depends on MCUX_HW_DEVICE_ID_MC56F82623

config MCUX_HW_IP_DriverType_DSC_CMP
    bool
    default y
    depends on MCUX_HW_DEVICE_ID_MC56F82623

config MCUX_HW_IP_DriverType_DSC_COP
    bool
    default y
    depends on MCUX_HW_DEVICE_ID_MC56F82623

config MCUX_HW_IP_DriverType_DSC_CRC16
    bool
    default y
    depends on MCUX_HW_DEVICE_ID_MC56F82623

config MCUX_HW_IP_DriverType_DSC_DMA
    bool
    default y
    depends on MCUX_HW_DEVICE_ID_MC56F82623

config MCUX_HW_IP_DriverType_DSC_EWM
    bool
    default y
    depends on MCUX_HW_DEVICE_ID_MC56F82623

config MCUX_HW_IP_DriverType_DSC_FTFA
    bool
    default y
    depends on MCUX_HW_DEVICE_ID_MC56F82623

config MCUX_HW_IP_DriverType_DSC_GPIO
    bool
    default y
    depends on MCUX_HW_DEVICE_ID_MC56F82623

config MCUX_HW_IP_DriverType_DSC_MCM
    bool
    default y
    depends on MCUX_HW_DEVICE_ID_MC56F82623

config MCUX_HW_IP_DriverType_DSC_PIT
    bool
    default y
    depends on MCUX_HW_DEVICE_ID_MC56F82623

config MCUX_HW_IP_DriverType_DSC_PMC
    bool
    default y
    depends on MCUX_HW_DEVICE_ID_MC56F82623

config MCUX_HW_IP_DriverType_DSC_PWM
    bool
    default y
    depends on MCUX_HW_DEVICE_ID_MC56F82623

config MCUX_HW_IP_DriverType_DSC_SIM
    bool
    default y
    depends on MCUX_HW_DEVICE_ID_MC56F82623

config MCUX_HW_IP_DriverType_DSC_TMR
    bool
    default y
    depends on MCUX_HW_DEVICE_ID_MC56F82623

config MCUX_HW_IP_DriverType_DSC_XBARA
    bool
    default y
    depends on MCUX_HW_DEVICE_ID_MC56F82623

config MCUX_HW_IP_DriverType_DSC_XBARB
    bool
    default y
    depends on MCUX_HW_DEVICE_ID_MC56F82623

config MCUX_HW_IP_DriverType_FMC
    bool
    default y
    depends on MCUX_HW_DEVICE_ID_MC56F82623

config MCUX_HW_IP_DriverType_INTC
    bool
    default y
    depends on MCUX_HW_DEVICE_ID_MC56F82623

config MCUX_HW_IP_DriverType_OCCS
    bool
    default y
    depends on MCUX_HW_DEVICE_ID_MC56F82623

config MCUX_HW_IP_DriverType_QSCI
    bool
    default y
    depends on MCUX_HW_DEVICE_ID_MC56F82623
```

## MC56F82xxx/MC56F82723/Kconfig
```kconfig
# Copyright 2024 NXP
#
# SPDX-License-Identifier: BSD-3-Clause

rsource "Kconfig.chip"
rsource "drivers/Kconfig"
rsource "../../../../devices/dsp56800/Kconfig.common"
rsource "Kconfig.defconfig"

## Project segment and component dependency data
config MCUX_HW_DEVICE_MC56F82723
    # bool "Device MC56F82723"
    bool
    default y
```

## MC56F82xxx/MC56F82726/Kconfig
```kconfig
# Copyright 2024 NXP
#
# SPDX-License-Identifier: BSD-3-Clause

rsource "Kconfig.chip"
rsource "drivers/Kconfig"
rsource "../../../../devices/dsp56800/Kconfig.common"
rsource "Kconfig.defconfig"

## Project segment and component dependency data
config MCUX_HW_DEVICE_MC56F82726
    # bool "Device MC56F82726"
    bool
    default y
```

## MC56F82xxx/MC56F82728/drivers/Kconfig
```kconfig
# Copyright 2024 NXP
#
# SPDX-License-Identifier: BSD-3-Clause

menu "Device specific drivers configuration"

    config MCUX_COMPONENT_driver.clock
         bool "clock"
         default y

endmenu
```

## MC56F82xxx/MC56F82743/Kconfig.chip
```kconfig
# core related
config MCUX_HW_CORE
    string
    default "dsp56800ex"

config MCUX_HW_CORE_DSP56800EX
    bool
    default y

config MCUX_HW_CORE_DSC
    bool
    default y

config MCUX_HW_CORE_ID
    string
    default "core0"

config MCUX_HW_CORE_ID_CORE0
    bool
    default y

config MCUX_HW_DEVICE_CORE
    string
    default "MC56F82743"

config MCUX_HW_FPU
    string
    default "NO_FPU"

config MCUX_HW_FPU_TYPE
    string
    default "no_fpu"

config MCUX_HW_NO_FPU
    bool
    default y

config MCUX_HW_SOC_SERIES_DSC
    bool
    default y

config MCUX_HW_SOC_SINGLECORE_DEVICE
    bool
    default y

# device related

config MCUX_HW_DEVICE_ID_MC56F82743
    bool

choice MCUX_HW_DEVICE_PART_MC56F82743
    prompt "Device MC56F82743 Part"
    config MCUX_HW_DEVICE_PART_MC56F82743VLC
        bool "Device part MC56F82743VLC"
        select MCUX_HW_DEVICE_ID_MC56F82743
    config MCUX_HW_DEVICE_PART_MC56F82743VFM
        bool "Device part MC56F82743VFM"
        select MCUX_HW_DEVICE_ID_MC56F82743
endchoice

config MCUX_HW_DEVICE_ID
    string
    default "MC56F82743" if MCUX_HW_DEVICE_ID_MC56F82743

config MCUX_HW_DEVICE_PART
    string
    default "MC56F82743VLC" if MCUX_HW_DEVICE_PART_MC56F82743VLC
    default "MC56F82743VFM" if MCUX_HW_DEVICE_PART_MC56F82743VFM

# For chipmodel generated files
config MCUX_TOOLCHAIN_LINKER_DEVICE_PREFIX
    string
    default "MC56F82743" if MCUX_HW_DEVICE_ID_MC56F82743

# Toolchain related

config MCUX_TOOLCHAIN_JLINK_CPU_IDENTIFIER
    string
    default "MC56F82743" if MCUX_HW_DEVICE_ID_MC56F82743

config MCUX_TOOLCHAIN_CODEWARRIOR_CPU_IDENTIFIER
    string
    default "MC56F827xx" if MCUX_HW_DEVICE_ID_MC56F82743

# ip information
config MCUX_HW_IP_DriverType_DSC_AOI
    bool
    default y
    depends on MCUX_HW_DEVICE_ID_MC56F82743

config MCUX_HW_IP_DriverType_DSC_CADC
    bool
    default y
    depends on MCUX_HW_DEVICE_ID_MC56F82743

config MCUX_HW_IP_DriverType_DSC_CMP
    bool
    default y
    depends on MCUX_HW_DEVICE_ID_MC56F82743

config MCUX_HW_IP_DriverType_DSC_COP
    bool
    default y
    depends on MCUX_HW_DEVICE_ID_MC56F82743

config MCUX_HW_IP_DriverType_DSC_CRC16
    bool
    default y
    depends on MCUX_HW_DEVICE_ID_MC56F82743

config MCUX_HW_IP_DriverType_DSC_DAC
    bool
    default y
    depends on MCUX_HW_DEVICE_ID_MC56F82743

config MCUX_HW_IP_DriverType_DSC_DMA
    bool
    default y
    depends on MCUX_HW_DEVICE_ID_MC56F82743

config MCUX_HW_IP_DriverType_DSC_EWM
    bool
    default y
    depends on MCUX_HW_DEVICE_ID_MC56F82743

config MCUX_HW_IP_DriverType_DSC_FTFA
    bool
    default y
    depends on MCUX_HW_DEVICE_ID_MC56F82743

config MCUX_HW_IP_DriverType_DSC_GPIO
    bool
    default y
    depends on MCUX_HW_DEVICE_ID_MC56F82743

config MCUX_HW_IP_DriverType_DSC_I2C
    bool
    default y
    depends on MCUX_HW_DEVICE_ID_MC56F82743

config MCUX_HW_IP_DriverType_DSC_MCM
    bool
    default y
    depends on MCUX_HW_DEVICE_ID_MC56F82743

config MCUX_HW_IP_DriverType_DSC_PIT
    bool
    default y
    depends on MCUX_HW_DEVICE_ID_MC56F82743

config MCUX_HW_IP_DriverType_DSC_PMC
    bool
    default y
    depends on MCUX_HW_DEVICE_ID_MC56F82743

config MCUX_HW_IP_DriverType_DSC_PWM
    bool
    default y
    depends on MCUX_HW_DEVICE_ID_MC56F82743

config MCUX_HW_IP_DriverType_DSC_SIM
    bool
    default y
    depends on MCUX_HW_DEVICE_ID_MC56F82743

config MCUX_HW_IP_DriverType_DSC_TMR
    bool
    default y
    depends on MCUX_HW_DEVICE_ID_MC56F82743

config MCUX_HW_IP_DriverType_DSC_XBARA
    bool
    default y
    depends on MCUX_HW_DEVICE_ID_MC56F82743

config MCUX_HW_IP_DriverType_DSC_XBARB
    bool
    default y
    depends on MCUX_HW_DEVICE_ID_MC56F82743

config MCUX_HW_IP_DriverType_FMC
    bool
    default y
    depends on MCUX_HW_DEVICE_ID_MC56F82743

config MCUX_HW_IP_DriverType_INTC
    bool
    default y
    depends on MCUX_HW_DEVICE_ID_MC56F82743

config MCUX_HW_IP_DriverType_OCCS
    bool
    default y
    depends on MCUX_HW_DEVICE_ID_MC56F82743

config MCUX_HW_IP_DriverType_QSCI
    bool
    default y
    depends on MCUX_HW_DEVICE_ID_MC56F82743

config MCUX_HW_IP_DriverType_QUEUED_SPI
    bool
    default y
    depends on MCUX_HW_DEVICE_ID_MC56F82743
```

## MC56F83xxx/MC56F83683/Kconfig
```kconfig
# Copyright 2024 NXP
#
# SPDX-License-Identifier: BSD-3-Clause

rsource "Kconfig.chip"
rsource "drivers/Kconfig"
rsource "../../../dsp56800/Kconfig.common"
rsource "Kconfig.defconfig"

## Project segment and component dependency data
config MCUX_HW_DEVICE_MC56F83683
    # bool "Device MC56F83683"
    bool
    default y

    # component dependency
    select MCUX_COMPONENT_driver.dsc_edma if MCUX_COMPONENT_driver.dsc_i2c_edma
    select MCUX_COMPONENT_driver.dsc_edma if MCUX_COMPONENT_driver.qsci_edma
    select MCUX_COMPONENT_component.qsci_adapter if MCUX_COMPONENT_utility.debug_console_lite
```

## MC56F83xxx/MC56F83789/Kconfig.chip
```kconfig
# core related
config MCUX_HW_CORE
    string
    default "dsp56800ex"

config MCUX_HW_CORE_DSP56800EX
    bool
    default y

config MCUX_HW_CORE_DSC
    bool
    default y

config MCUX_HW_CORE_ID
    string
    default "core0"

config MCUX_HW_CORE_ID_CORE0
    bool
    default y

config MCUX_HW_DEVICE_CORE
    string
    default "MC56F83789"

config MCUX_HW_FPU
    string
    default "NO_FPU"

config MCUX_HW_FPU_TYPE
    string
    default "no_fpu"

config MCUX_HW_NO_FPU
    bool
    default y

config MCUX_HW_SOC_SERIES_DSC
    bool
    default y

config MCUX_HW_SOC_SINGLECORE_DEVICE
    bool
    default y

# device related

config MCUX_HW_DEVICE_ID_MC56F83789
    bool

choice MCUX_HW_DEVICE_PART_MC56F83789
    prompt "Device MC56F83789 Part"
    config MCUX_HW_DEVICE_PART_MC56F83789VLL
        bool "MC56F83789VLL"
        select MCUX_HW_DEVICE_ID_MC56F83789
    config MCUX_HW_DEVICE_PART_MC56F83789AVLL
        bool "MC56F83789AVLL"
        select MCUX_HW_DEVICE_ID_MC56F83789
endchoice

config MCUX_HW_DEVICE_ID
    string
    default "MC56F83789" if MCUX_HW_DEVICE_ID_MC56F83789

config MCUX_HW_DEVICE_PART
    string
    default "MC56F83789VLL" if MCUX_HW_DEVICE_PART_MC56F83789VLL
    default "MC56F83789AVLL" if MCUX_HW_DEVICE_PART_MC56F83789AVLL

# For chipmodel generated files
config MCUX_TOOLCHAIN_LINKER_DEVICE_PREFIX
    string
    default "MC56F83789" if MCUX_HW_DEVICE_ID_MC56F83789

# Toolchain related

config MCUX_TOOLCHAIN_CODEWARRIOR_CPU_IDENTIFIER
    string
    default "MC56F837xx" if MCUX_HW_DEVICE_ID_MC56F83789

# ip information
config MCUX_HW_IP_DriverType_DSC_CADC
    bool
    default y
    depends on MCUX_HW_DEVICE_ID_MC56F83789

config MCUX_HW_IP_DriverType_DSC_CMP
    bool
    default y
    depends on MCUX_HW_DEVICE_ID_MC56F83789

config MCUX_HW_IP_DriverType_DSC_COP
    bool
    default y
    depends on MCUX_HW_DEVICE_ID_MC56F83789

config MCUX_HW_IP_DriverType_DSC_CRC
    bool
    default y
    depends on MCUX_HW_DEVICE_ID_MC56F83789

config MCUX_HW_IP_DriverType_DSC_DAC
    bool
    default y
    depends on MCUX_HW_DEVICE_ID_MC56F83789

config MCUX_HW_IP_DriverType_DSC_DMAMUX
    bool
    default y
    depends on MCUX_HW_DEVICE_ID_MC56F83789

config MCUX_HW_IP_DriverType_DSC_EDMA
    bool
    default y
    depends on MCUX_HW_DEVICE_ID_MC56F83789

config MCUX_HW_IP_DriverType_DSC_EVTG
    bool
    default y
    depends on MCUX_HW_DEVICE_ID_MC56F83789

config MCUX_HW_IP_DriverType_DSC_EWM
    bool
    default y
    depends on MCUX_HW_DEVICE_ID_MC56F83789

config MCUX_HW_IP_DriverType_DSC_FLEXCAN
    bool
    default y
    depends on MCUX_HW_DEVICE_ID_MC56F83789

config MCUX_HW_IP_DriverType_DSC_FTFE
    bool
    default y
    depends on MCUX_HW_DEVICE_ID_MC56F83789

config MCUX_HW_IP_DriverType_DSC_GPIO
    bool
    default y
    depends on MCUX_HW_DEVICE_ID_MC56F83789

config MCUX_HW_IP_DriverType_DSC_I2C
    bool
    default y
    depends on MCUX_HW_DEVICE_ID_MC56F83789

config MCUX_HW_IP_DriverType_DSC_MCM
    bool
    default y
    depends on MCUX_HW_DEVICE_ID_MC56F83789

config MCUX_HW_IP_DriverType_DSC_PIT
    bool
    default y
    depends on MCUX_HW_DEVICE_ID_MC56F83789

config MCUX_HW_IP_DriverType_DSC_PMC
    bool
    default y
    depends on MCUX_HW_DEVICE_ID_MC56F83789

config MCUX_HW_IP_DriverType_DSC_PWM
    bool
    default y
    depends on MCUX_HW_DEVICE_ID_MC56F83789

config MCUX_HW_IP_DriverType_DSC_SIM
    bool
    default y
    depends on MCUX_HW_DEVICE_ID_MC56F83789

config MCUX_HW_IP_DriverType_DSC_TMR
    bool
    default y
    depends on MCUX_HW_DEVICE_ID_MC56F83789

config MCUX_HW_IP_DriverType_DSC_XBARA
    bool
    default y
    depends on MCUX_HW_DEVICE_ID_MC56F83789

config MCUX_HW_IP_DriverType_INTC
    bool
    default y
    depends on MCUX_HW_DEVICE_ID_MC56F83789

config MCUX_HW_IP_DriverType_OCCS
    bool
    default y
    depends on MCUX_HW_DEVICE_ID_MC56F83789

config MCUX_HW_IP_DriverType_QSCI
    bool
    default y
    depends on MCUX_HW_DEVICE_ID_MC56F83789

config MCUX_HW_IP_DriverType_QUEUED_SPI
    bool
    default y
    depends on MCUX_HW_DEVICE_ID_MC56F83789

config MCUX_HW_IP_DriverType_USB_DEVICE_KHCI
    bool
    default y
    depends on MCUX_HW_DEVICE_ID_MC56F83789
```

## MC56F83xxx/MC56F83789/drivers/Kconfig
```kconfig
# Copyright 2024 NXP
#
# SPDX-License-Identifier: BSD-3-Clause

config MCUX_HAS_COMPONENT_driver.dsc_flash_romapi
  bool
  default y

config MCUX_HAS_COMPONENT_driver.dsc_device_sim
  bool
  default y

menu "Device specific drivers configuration"

    config MCUX_COMPONENT_driver.clock
         bool "clock"
         default y

    config MCUX_COMPONENT_driver.dsc_flash_romapi
         bool "flash"
         default y if MCUX_HAS_COMPONENT_driver.dsc_flash_romapi

    config MCUX_COMPONENT_driver.dsc_device_sim
         bool "sim"
         default y

endmenu
```

## MC56F84xxx/MC56F84452/drivers/Kconfig
```kconfig
# Copyright 2024-2025 NXP
#
# SPDX-License-Identifier: BSD-3-Clause



rsource "../../../MC56F84xxx/MC56F84789/drivers/Kconfig"
```
