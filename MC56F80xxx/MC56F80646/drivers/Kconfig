## MC56F80xxx/MC56F80646/drivers/Kconfig
```kconfig
# Copyright 2024-2025 NXP
#
# SPDX-License-Identifier: BSD-3-Clause



rsource "../../../MC56F80xxx/MC56F80748/drivers/Kconfig"
```

## MC56F80xxx/MC56F80723/Kconfig.chip
```kconfig
# core related
config MCUX_HW_CORE
    string
    default "dsp56800ef"

config MCUX_HW_CORE_DSP56800EF
    bool
    default y

config MCUX_HW_CORE_DSC
    bool
    default y

config MCUX_HW_CORE_ID
    string
    default "core0"

config MCUX_HW_CORE_ID_CORE0
    bool
    default y

config MCUX_HW_DEVICE_CORE
    string
    default "MC56F80723"

config MCUX_HW_FPU
    string
    default "SP_FPU"

config MCUX_HW_FPU_TYPE
    string
    default "sp_fpu"

config MCUX_HW_NO_FPU
    bool
    default n

config MCUX_HW_SOC_SERIES_DSC
    bool
    default y

config MCUX_HW_SOC_SINGLECORE_DEVICE
    bool
    default y

# device related

config MCUX_HW_DEVICE_ID_MC56F80723
    bool

choice
    prompt "Device MC56F80723 Part"
    config MCUX_HW_DEVICE_PART_MC56F80723VLC
        bool "Device part MC56F80723VLC"
        select MCUX_HW_DEVICE_ID_MC56F80723
endchoice

config MCUX_HW_DEVICE_ID
    string
    default "MC56F80723" if MCUX_HW_DEVICE_ID_MC56F80723

config MCUX_HW_DEVICE_PART
    string
    default "MC56F80723VLC" if MCUX_HW_DEVICE_PART_MC56F80723VLC

# For chipmodel generated files
config MCUX_TOOLCHAIN_LINKER_DEVICE_PREFIX
    string
    default "MC56F80723" if MCUX_HW_DEVICE_ID_MC56F80723

# Toolchain related

config MCUX_TOOLCHAIN_JLINK_CPU_IDENTIFIER
    string
    default "MC56F80723" if MCUX_HW_DEVICE_ID_MC56F80723

config MCUX_TOOLCHAIN_CODEWARRIOR_CPU_IDENTIFIER
    string
    default "MC56F807xx" if MCUX_HW_DEVICE_ID_MC56F80723

# ip information
config MCUX_HW_IP_DriverType_DSC_CADC
    bool
    default y
    depends on MCUX_HW_DEVICE_ID_MC56F80723

config MCUX_HW_IP_DriverType_DSC_CMP
    bool
    default y
    depends on MCUX_HW_DEVICE_ID_MC56F80723

config MCUX_HW_IP_DriverType_DSC_COP
    bool
    default y
    depends on MCUX_HW_DEVICE_ID_MC56F80723

config MCUX_HW_IP_DriverType_DSC_CRC
    bool
    default y
    depends on MCUX_HW_DEVICE_ID_MC56F80723

config MCUX_HW_IP_DriverType_DSC_DMAMUX
    bool
    default y
    depends on MCUX_HW_DEVICE_ID_MC56F80723

config MCUX_HW_IP_DriverType_DSC_EDMA
    bool
    default y
    depends on MCUX_HW_DEVICE_ID_MC56F80723

config MCUX_HW_IP_DriverType_DSC_EQDC
    bool
    default y
    depends on MCUX_HW_DEVICE_ID_MC56F80723

config MCUX_HW_IP_DriverType_DSC_EVTG
    bool
    default y
    depends on MCUX_HW_DEVICE_ID_MC56F80723

config MCUX_HW_IP_DriverType_DSC_EWM
    bool
    default y
    depends on MCUX_HW_DEVICE_ID_MC56F80723

config MCUX_HW_IP_DriverType_DSC_FTFA
    bool
    default y
    depends on MCUX_HW_DEVICE_ID_MC56F80723

config MCUX_HW_IP_DriverType_DSC_GPIO
    bool
    default y
    depends on MCUX_HW_DEVICE_ID_MC56F80723

config MCUX_HW_IP_DriverType_DSC_LPI2C
    bool
    default y
    depends on MCUX_HW_DEVICE_ID_MC56F80723

config MCUX_HW_IP_DriverType_DSC_MCM
    bool
    default y
    depends on MCUX_HW_DEVICE_ID_MC56F80723

config MCUX_HW_IP_DriverType_DSC_OPAMP
    bool
    default y
    depends on MCUX_HW_DEVICE_ID_MC56F80723

config MCUX_HW_IP_DriverType_DSC_PIT
    bool
    default y
    depends on MCUX_HW_DEVICE_ID_MC56F80723

config MCUX_HW_IP_DriverType_DSC_PMC
    bool
    default y
    depends on MCUX_HW_DEVICE_ID_MC56F80723

config MCUX_HW_IP_DriverType_DSC_PWM
    bool
    default y
    depends on MCUX_HW_DEVICE_ID_MC56F80723

#config MCUX_HW_IP_DriverType_DSC_SIM
#    bool
#    default y
#    depends on MCUX_HW_DEVICE_ID_MC56F80723

config MCUX_HW_IP_DriverType_DSC_TMR
    bool
    default y
    depends on MCUX_HW_DEVICE_ID_MC56F80723

config MCUX_HW_IP_DriverType_DSC_XBARA
    bool
    default y
    depends on MCUX_HW_DEVICE_ID_MC56F80723

config MCUX_HW_IP_DriverType_FMC
    bool
    default y
    depends on MCUX_HW_DEVICE_ID_MC56F80723

config MCUX_HW_IP_DriverType_INTC
    bool
    default y
    depends on MCUX_HW_DEVICE_ID_MC56F80723

config MCUX_HW_IP_DriverType_OCCS
    bool
    default y
    depends on MCUX_HW_DEVICE_ID_MC56F80723

config MCUX_HW_IP_DriverType_QSCI
    bool
    default y
    depends on MCUX_HW_DEVICE_ID_MC56F80723

config MCUX_HW_IP_DriverType_QUEUED_SPI
    bool
    default y
    depends on MCUX_HW_DEVICE_ID_MC56F80723
```

## MC56F81xxx/MC56F81646/Kconfig.chip
```kconfig
# core related
config MCUX_HW_CORE
    string
    default "dsp56800ex"

config MCUX_HW_CORE_DSP56800EX
    bool
    default y

config MCUX_HW_CORE_DSC
    bool
    default y

config MCUX_HW_CORE_ID
    string
    default "core0"

config MCUX_HW_CORE_ID_CORE0
    bool
    default y

config MCUX_HW_DEVICE_CORE
    string
    default "MC56F81646"

config MCUX_HW_FPU
    string
    default "NO_FPU"

config MCUX_HW_FPU_TYPE
    string
    default "no_fpu"

config MCUX_HW_NO_FPU
    bool
    default y

config MCUX_HW_SOC_SERIES_DSC
    bool
    default y

config MCUX_HW_SOC_SINGLECORE_DEVICE
    bool
    default y

# device related

config MCUX_HW_DEVICE_ID_MC56F81646
    bool

choice MCUX_HW_DEVICE_PART_MC56F81646
    prompt "Device MC56F81646 Part"
    config MCUX_HW_DEVICE_PART_MC56F81646LVLF
        bool "MC56F81646LVLF"
        select MCUX_HW_DEVICE_ID_MC56F81646
endchoice

config MCUX_HW_DEVICE_ID
    string
    default "MC56F81646" if MCUX_HW_DEVICE_ID_MC56F81646

config MCUX_HW_DEVICE_PART
    string
    default "MC56F81646LVLF" if MCUX_HW_DEVICE_PART_MC56F81646LVLF

# For chipmodel generated files
config MCUX_TOOLCHAIN_LINKER_DEVICE_PREFIX
    string
    default "MC56F81646" if MCUX_HW_DEVICE_ID_MC56F81646

# Toolchain related

config MCUX_TOOLCHAIN_CODEWARRIOR_CPU_IDENTIFIER
    string
    default "MC56F816xx" if MCUX_HW_DEVICE_ID_MC56F81646

# ip information
config MCUX_HW_IP_DriverType_DSC_CADC
    bool
    default y
    depends on MCUX_HW_DEVICE_ID_MC56F81646

config MCUX_HW_IP_DriverType_DSC_CMP
    bool
    default y
    depends on MCUX_HW_DEVICE_ID_MC56F81646

config MCUX_HW_IP_DriverType_DSC_COP
    bool
    default y
    depends on MCUX_HW_DEVICE_ID_MC56F81646

config MCUX_HW_IP_DriverType_DSC_CRC
    bool
    default y
    depends on MCUX_HW_DEVICE_ID_MC56F81646

config MCUX_HW_IP_DriverType_DSC_DMAMUX
    bool
    default y
    depends on MCUX_HW_DEVICE_ID_MC56F81646

config MCUX_HW_IP_DriverType_DSC_EDMA
    bool
    default y
    depends on MCUX_HW_DEVICE_ID_MC56F81646

config MCUX_HW_IP_DriverType_DSC_EVTG
    bool
    default y
    depends on MCUX_HW_DEVICE_ID_MC56F81646

config MCUX_HW_IP_DriverType_DSC_EWM
    bool
    default y
    depends on MCUX_HW_DEVICE_ID_MC56F81646

config MCUX_HW_IP_DriverType_DSC_FTFA
    bool
    default y
    depends on MCUX_HW_DEVICE_ID_MC56F81646

config MCUX_HW_IP_DriverType_DSC_GPIO
    bool
    default y
    depends on MCUX_HW_DEVICE_ID_MC56F81646

config MCUX_HW_IP_DriverType_DSC_LPI2C
    bool
    default y
    depends on MCUX_HW_DEVICE_ID_MC56F81646

config MCUX_HW_IP_DriverType_DSC_MCM
    bool
    default y
    depends on MCUX_HW_DEVICE_ID_MC56F81646

config MCUX_HW_IP_DriverType_DSC_OPAMP
    bool
    default y
    depends on MCUX_HW_DEVICE_ID_MC56F81646

config MCUX_HW_IP_DriverType_DSC_PIT
    bool
    default y
    depends on MCUX_HW_DEVICE_ID_MC56F81646

config MCUX_HW_IP_DriverType_DSC_PMC
    bool
    default y
    depends on MCUX_HW_DEVICE_ID_MC56F81646

config MCUX_HW_IP_DriverType_DSC_PWM
    bool
    default y
    depends on MCUX_HW_DEVICE_ID_MC56F81646

config MCUX_HW_IP_DriverType_DSC_QDC
    bool
    default y
    depends on MCUX_HW_DEVICE_ID_MC56F81646

#config MCUX_HW_IP_DriverType_DSC_SIM
#    bool
#    default y
#    depends on MCUX_HW_DEVICE_ID_MC56F81646

config MCUX_HW_IP_DriverType_DSC_TMR
    bool
    default y
    depends on MCUX_HW_DEVICE_ID_MC56F81646

config MCUX_HW_IP_DriverType_DSC_XBARA
    bool
    default y
    depends on MCUX_HW_DEVICE_ID_MC56F81646

config MCUX_HW_IP_DriverType_FMC
    bool
    default y
    depends on MCUX_HW_DEVICE_ID_MC56F81646

config MCUX_HW_IP_DriverType_INTC
    bool
    default y
    depends on MCUX_HW_DEVICE_ID_MC56F81646

config MCUX_HW_IP_DriverType_OCCS
    bool
    default y
    depends on MCUX_HW_DEVICE_ID_MC56F81646

config MCUX_HW_IP_DriverType_QSCI
    bool
    default y
    depends on MCUX_HW_DEVICE_ID_MC56F81646
```

## MC56F81xxx/MC56F81648/drivers/Kconfig
```kconfig
# Copyright 2024 NXP
#
# SPDX-License-Identifier: BSD-3-Clause

config MCUX_HAS_COMPONENT_driver.dsc_flash_romapi
  bool
  default y

menu "Device specific drivers configuration"

    config MCUX_COMPONENT_driver.clock
         bool "clock"
         default y

    config MCUX_COMPONENT_driver.dsc_flash_romapi
         bool "flash"
         default y if MCUX_HAS_COMPONENT_driver.dsc_flash_romapi

    config MCUX_COMPONENT_driver.dsc_sim_mc56f81xxx
         bool "sim"
         default y

endmenu
```

## MC56F81xxx/MC56F81746/drivers/Kconfig
```kconfig
# Copyright 2024 NXP
#
# SPDX-License-Identifier: BSD-3-Clause

menu "Device specific drivers configuration"

    config MCUX_COMPONENT_driver.clock
         bool "clock"
         default y

    config MCUX_COMPONENT_driver.dsc_sim_mc56f81xxx
         bool "sim"
         default y

endmenu
```

## MC56F81xxx/MC56F81763/drivers/Kconfig
```kconfig
# Copyright 2024-2025 NXP
#
# SPDX-License-Identifier: BSD-3-Clause



rsource "../../../MC56F81xxx/MC56F81768/drivers/Kconfig"
```

## MC56F81xxx/MC56F81768/Kconfig.chip
```kconfig
# core related
config MCUX_HW_CORE
    string
    default "dsp56800ex"

config MCUX_HW_CORE_DSP56800EX
    bool
    default y

config MCUX_HW_CORE_DSC
    bool
    default y

config MCUX_HW_CORE_ID
    string
    default "core0"

config MCUX_HW_CORE_ID_CORE0
    bool
    default y

config MCUX_HW_DEVICE_CORE
    string
    default "MC56F81768"

config MCUX_HW_FPU
    string
    default "NO_FPU"

config MCUX_HW_FPU_TYPE
    string
    default "no_fpu"

config MCUX_HW_NO_FPU
    bool
    default y

config MCUX_HW_SOC_SERIES_DSC
    bool
    default y

config MCUX_HW_SOC_SINGLECORE_DEVICE
    bool
    default y

# device related

config MCUX_HW_DEVICE_ID_MC56F81768
    bool

choice MCUX_HW_DEVICE_PART_MC56F81768
    prompt "Device MC56F81768 Part"
    config MCUX_HW_DEVICE_PART_MC56F81768LVLH
        bool "MC56F81768LVLH"
        select MCUX_HW_DEVICE_ID_MC56F81768
    config MCUX_HW_DEVICE_PART_MC56F81768AMLHA
        bool "MC56F81768AMLHA"
        select MCUX_HW_DEVICE_ID_MC56F81768
    config MCUX_HW_DEVICE_PART_MC56F81768LMLH
        bool "MC56F81768LMLH"
        select MCUX_HW_DEVICE_ID_MC56F81768
endchoice

config MCUX_HW_DEVICE_ID
    string
    default "MC56F81768" if MCUX_HW_DEVICE_ID_MC56F81768

config MCUX_HW_DEVICE_PART
    string
    default "MC56F81768AMLHA" if MCUX_HW_DEVICE_PART_MC56F81768AMLHA
    default "MC56F81768LMLH" if MCUX_HW_DEVICE_PART_MC56F81768LMLH
    default "MC56F81768LVLH" if MCUX_HW_DEVICE_PART_MC56F81768LVLH

# For chipmodel generated files
config MCUX_TOOLCHAIN_LINKER_DEVICE_PREFIX
    string
    default "MC56F81768" if MCUX_HW_DEVICE_ID_MC56F81768

# Toolchain related

config MCUX_TOOLCHAIN_CODEWARRIOR_CPU_IDENTIFIER
    string
    default "MC56F817xx" if MCUX_HW_DEVICE_ID_MC56F81768

# ip information
config MCUX_HW_IP_DriverType_DSC_CADC
    bool
    default y
    depends on MCUX_HW_DEVICE_ID_MC56F81768

config MCUX_HW_IP_DriverType_DSC_CMP
    bool
    default y
    depends on MCUX_HW_DEVICE_ID_MC56F81768

config MCUX_HW_IP_DriverType_DSC_COP
    bool
    default y
    depends on MCUX_HW_DEVICE_ID_MC56F81768

config MCUX_HW_IP_DriverType_DSC_CRC
    bool
    default y
    depends on MCUX_HW_DEVICE_ID_MC56F81768

config MCUX_HW_IP_DriverType_DSC_DAC
    bool
    default y
    depends on MCUX_HW_DEVICE_ID_MC56F81768

config MCUX_HW_IP_DriverType_DSC_DMAMUX
    bool
    default y
    depends on MCUX_HW_DEVICE_ID_MC56F81768

config MCUX_HW_IP_DriverType_DSC_EDMA
    bool
    default y
    depends on MCUX_HW_DEVICE_ID_MC56F81768

config MCUX_HW_IP_DriverType_DSC_EVTG
    bool
    default y
    depends on MCUX_HW_DEVICE_ID_MC56F81768

config MCUX_HW_IP_DriverType_DSC_EWM
    bool
    default y
    depends on MCUX_HW_DEVICE_ID_MC56F81768

config MCUX_HW_IP_DriverType_DSC_FTFA
    bool
    default y
    depends on MCUX_HW_DEVICE_ID_MC56F81768

config MCUX_HW_IP_DriverType_DSC_GPIO
    bool
    default y
    depends on MCUX_HW_DEVICE_ID_MC56F81768

config MCUX_HW_IP_DriverType_DSC_LPI2C
    bool
    default y
    depends on MCUX_HW_DEVICE_ID_MC56F81768

config MCUX_HW_IP_DriverType_DSC_MCM
    bool
    default y
    depends on MCUX_HW_DEVICE_ID_MC56F81768

config MCUX_HW_IP_DriverType_DSC_OPAMP
    bool
    default y
    depends on MCUX_HW_DEVICE_ID_MC56F81768

config MCUX_HW_IP_DriverType_DSC_PIT
    bool
    default y
    depends on MCUX_HW_DEVICE_ID_MC56F81768

config MCUX_HW_IP_DriverType_DSC_PMC
    bool
    default y
    depends on MCUX_HW_DEVICE_ID_MC56F81768

config MCUX_HW_IP_DriverType_DSC_PWM
    bool
    default y
    depends on MCUX_HW_DEVICE_ID_MC56F81768

config MCUX_HW_IP_DriverType_DSC_QDC
    bool
    default y
    depends on MCUX_HW_DEVICE_ID_MC56F81768

config MCUX_HW_IP_DriverType_DSC_SIM
    bool
    default y
    depends on MCUX_HW_DEVICE_ID_MC56F81768

config MCUX_HW_IP_DriverType_DSC_TMR
    bool
    default y
    depends on MCUX_HW_DEVICE_ID_MC56F81768

config MCUX_HW_IP_DriverType_DSC_XBARA
    bool
    default y
    depends on MCUX_HW_DEVICE_ID_MC56F81768

config MCUX_HW_IP_DriverType_FMC
    bool
    default y
    depends on MCUX_HW_DEVICE_ID_MC56F81768

config MCUX_HW_IP_DriverType_INTC
    bool
    default y
    depends on MCUX_HW_DEVICE_ID_MC56F81768

config MCUX_HW_IP_DriverType_OCCS
    bool
    default y
    depends on MCUX_HW_DEVICE_ID_MC56F81768

config MCUX_HW_IP_DriverType_QSCI
    bool
    default y
    depends on MCUX_HW_DEVICE_ID_MC56F81768

config MCUX_HW_IP_DriverType_QUEUED_SPI
    bool
    default y
    depends on MCUX_HW_DEVICE_ID_MC56F81768
```

## MC56F81xxx/MC56F81768/drivers/Kconfig
```kconfig
# Copyright 2024 NXP
#
# SPDX-License-Identifier: BSD-3-Clause

config MCUX_HAS_COMPONENT_driver.dsc_device_sim
  bool
  default y

menu "Device specific drivers configuration"

    config MCUX_COMPONENT_driver.clock
         bool "clock"
         default y

    config MCUX_COMPONENT_driver.dsc_device_sim
         bool "sim"
         default y

endmenu
```

## MC56F82xxx/MC56F82316/drivers/Kconfig
```kconfig
# Copyright 2024-2025 NXP
#
# SPDX-License-Identifier: BSD-3-Clause



rsource "../../../MC56F82xxx/MC56F82748/drivers/Kconfig"
```
